## arch/arm/configs/msm8916_sec_novel_kx_defconfig
```kconfig
CONFIG_SEC_NOVEL_PROJECT=y
CONFIG_MACH_NOVEL_KOR_OPEN=y

# SS Pinctrl Driver
CONFIG_SEC_GPIO_SETTINGS=y

# MUIC
CONFIG_SM5703_MUIC=y
CONFIG_USBID_STANDARD_VER_01=y
CONFIG_MUIC_SUPPORT_CHARGING_CABLE=y
CONFIG_MUIC_SUPPORT_RUSTPROOF=y
CONFIG_MUIC_SUPPORT_DESKDOCK=y

#sensor
# CONFIG_SENSORS_ADSP is not set
# CONFIG_SENSORS_BMA255 is not set
# CONFIG_SENSORS_GP2A030A is not set
# CONFIG_SENSORS_GP2A030A_PROX is not set
# CONFIG_SENSORS_HSCDTD008A is not set

#SENSOR
CONFIG_IIO=y
CONFIG_IIO_BUFFER=y
CONFIG_IIO_KFIFO_BUF=y
CONFIG_IIO_TRIGGER=y
CONFIG_ICM_MPU_IIO=y

CONFIG_SENSORS_CORE=y
#CONFIG_SENSORS_K2HH is not set
#CONFIG_SENSORS_K2HH_VDD is not set
CONFIG_SENSORS_CM36686=y
CONFIG_SENSORS_CM36686_LEDA_EN_GPIO=y


#Wifi
#
# Enable Qualcomm Wifi features
#
#CONFIG_MSM_PIL_PRONTO=y
#CONFIG_WCNSS_CORE=y
#CONFIG_WCNSS_CORE_PRONTO=y
#CONFIG_WCNSS_MEM_PRE_ALLOC=y
#
# Wifi features (Qualcomm)
#
#CONFIG_NET_CORE=y
#CONFIG_WIRELESS=y
#CONFIG_WIRELESS_EXT_SYSFS=y
#CONFIG_WEXT_CORE=y
#CONFIG_WEXT_PROC=y
#CONFIG_CFG80211=y
#CONFIG_CFG80211_DEFAULT_PS=y
#CONFIG_WLAN_REGION_CODE=300
#CONFIG_TARGET_LOCALE_CHN=y
#CONFIG_CFG80211_ALLOW_RECONNECT is not set
#CONFIG_WLAN=y
#CONFIG_WIRELESS_EXT=y
#CONFIG_WEXT_PRIV=y
#CONFIG_MODULES=y
#CONFIG_MODULE_UNLOAD=y
#CONFIG_MODULE_FORCE_UNLOAD=y
#CONFIG_WCNSS_REGISTER_DUMP_ON_BITE =y


#Touch Screen
CONFIG_TOUCHSCREEN_IST30XXC=y
CONFIG_TOUCHSCREEN_TA_CALLBACK_ENABLE=y
CONFIG_KEYBOARD_STMPE1801=y

# VIBRATOR
CONFIG_MSM_VIBRATOR=y

#HALL IC
CONFIG_SENSORS_HALL=y

#SVC LED
CONFIG_LEDS_KTD2026=y

#AUDIO
CONFIG_RADIO_IRIS=y
CONFIG_RADIO_IRIS_TRANSPORT=m

#LCD
CONFIG_PANEL_SC7798D_BV038WVM_WVGA=y

# Pre-power on alarm
# CONFIG_RTC_AUTO_PWRON is not set
# CONFIG_RTC_AUTO_PWRON_PARAM is not set

#CAMERA
CONFIG_S5K4H5YB=y
CONFIG_S5K6B2YX=y
CONFIG_CAM_USE_GPIO_I2C=y

#FLASH

#optimize mmc block delay on resume
#CONFIG_MMC_BLOCK_DEFERRED_RESUME=y

#MMC
CONFIG_BLOCK=y
CONFIG_BLK_DEV_IO_TRACE=y

#optimize mmc block delay on resume
CONFIG_MMC_BLOCK_DEFERRED_RESUME=y

#for sd card of no detect pin 
CONFIG_NO_DETECT_PIN=y

# RTCC v3
#CONFIG_SWAP=y
#CONFIG_ZSMALLOC=y
CONFIG_ZRAM=y
#CONFIG_RUNTIME_COMPCACHE=y
#CONFIG_KSWAPD_NOSWAP=y


#NFC
CONFIG_SEC_NFC=y
CONFIG_SEC_NFC_I2C=y
CONFIG_SEC_NFC_USE_8916_BBCLK2=y
CONFIG_SEC_NFC_IF_I2C=y
CONFIG_SEC_NFC_PRODUCT_N5=y

#CONFIGURE Knox UID PID
#CONFIG_KNOX_VPN_UID_PID is not set

# Charging/Battery
CONFIG_MFD_SM5703=y
CONFIG_REGULATOR_SM5703=y
CONFIG_CHARGER_SM5703=y
CONFIG_BATTERY_SAMSUNG=y
CONFIG_BATTERY_SAMSUNG_DATA_FILE="novel_battery_data.h"
CONFIG_SAMSUNG_LPM_MODE=y
CONFIG_FUELGAUGE_SM5703=y
CONFIG_BATTERY_SWELLING=y
# CONFIG_SIOP_CHARGING_LIMIT_CURRENT=700

# DUAL SIM / SINGLE SIM Detection
# CONFIG_CHECK_SIMSLOT_COUNT is not set
# CONFIG_CHECK_SIMSLOT_COUNT_GPIO is not set
# CONFIG_CHECK_SIMSLOT_COUNT_DT is not set

# IPSec
#CONFIG_CRYPTO_NULL=y

# A-KSM
CONFIG_KSM=y
CONFIG_ADAPTIVE_KSM=y

# DMB
CONFIG_TDMB=y
CONFIG_TDMB_VENDOR_RAONTECH=y
CONFIG_TDMB_MTV319=y
CONFIG_TDMB_SPI=y
CONFIG_TDMB_QUALCOMM=y
CONFIG_TDMB_FM_ANT_SEL=y
```
